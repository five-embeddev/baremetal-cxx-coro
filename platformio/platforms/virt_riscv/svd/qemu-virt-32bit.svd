# virt-32bit register map
Vendor: QEMU
32-bit RV32GC core
CPU: other, little endian
Registers are 32-bit, read-write, reset 0x0 unless marked. A register's access mark holds for its fields unless they carry their own. Offsets are from the block's base; lines under a group give offsets from that group; [hi:lo] are bit positions; {n}, {i} and the like mark numbered series; 'fields as' and 'values as' point back to an identical list; <NAME> marks a mode.

## Memory map
0x02000000 CLINT size 0x10000 — Core Local Interruptor.
0x0C000000 PLIC size 0x200008 — Platform-Level Interrupt Controller.

## PLIC — Platform-Level Interrupt Controller.
Base 0x0C000000
{0x0+4i} PRIORITY[{i}] (i=0..51) — PLIC Interrupt Priority Register.
  [2:0] PRIORITY
0x1000 PENDING_1 — PLIC Interrupt Pending Register 1.
0x1004 PENDING_2 — PLIC Interrupt Pending Register 2.
0x2000 ENABLE_1 — PLIC Interrupt Enable Register 1.
0x2004 ENABLE_2 — PLIC Interrupt Enable Register 2.
0x200000 THRESHOLD — PLIC Interrupt Priority Threshold Register.
  [2:0] THRESHOLD
0x200004 CLAIM — PLIC Claim/Complete Register.

## CLINT — Core Local Interruptor.
Base 0x02000000
0x00 MSIP — Machine Software Interrupt Pending Register.
0x4000 MTIMECMP_LO — Machine Timer Compare Register Low.
0x4004 MTIMECMP_HI — Machine Timer Compare Register High.
0xBFF8 MTIME_LO — Machine Timer Register Low.
0xBFFC MTIME_HI — Machine Timer Register High.
